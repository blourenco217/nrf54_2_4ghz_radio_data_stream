## CMakeLists.txt
```
#
# Copyright (c) 2024 Nordic Semiconductor
#
# SPDX-License-Identifier: LicenseRef-Nordic-5-Clause
#

cmake_minimum_required(VERSION 3.20.0)
find_package(Zephyr REQUIRED HINTS $ENV{ZEPHYR_BASE})
project(ble_data_transmission)

target_include_directories(app PRIVATE include)
target_sources(app PRIVATE
    src/main.c
    src/central.c
    src/peripheral.c
    src/esb_link.c
)
```

## Kconfig.sysbuild
```
#
# Copyright (c) 2024 Nordic Semiconductor
#
# SPDX-License-Identifier: LicenseRef-Nordic-5-Clause
#

source "share/sysbuild/Kconfig"

config NRF_DEFAULT_BLUETOOTH
	default y

config NETCORE_IPC_RADIO_BT_HCI_IPC
	default y
```

## sample.yaml
```
sample:
  description: Bluetooth Connection time synchronization sample
  name: Bluetooth Connection time synchronization
tests:
  sample.bluetooth.conn_time_sync:
    sysbuild: true
    build_only: true
    integration_platforms:
      - nrf52840dk/nrf52840
      - nrf52833dk/nrf52833
      - nrf5340dk/nrf5340/cpuapp
      - nrf54l15dk/nrf54l05/cpuapp
      - nrf54l15dk/nrf54l10/cpuapp
      - nrf54l15dk/nrf54l15/cpuapp
      - nrf54h20dk/nrf54h20/cpuapp
    platform_allow:
      - nrf52840dk/nrf52840
      - nrf52833dk/nrf52833
      - nrf5340dk/nrf5340/cpuapp
      - nrf54l15dk/nrf54l05/cpuapp
      - nrf54l15dk/nrf54l10/cpuapp
      - nrf54l15dk/nrf54l15/cpuapp
      - nrf54h20dk/nrf54h20/cpuapp
    tags:
      - bluetooth
      - ci_build
      - sysbuild
```

## prj.conf
```kconfig
#
# Copyright (c) 2024 Nordic Semiconductor
#
# SPDX-License-Identifier: LicenseRef-Nordic-5-Clause
#

CONFIG_NCS_SAMPLES_DEFAULTS=y
CONFIG_BT=n
CONFIG_ESB=y
CONFIG_ESB_MAX_PAYLOAD_LENGTH=2
CONFIG_CONSOLE=y
CONFIG_CONSOLE_SUBSYS=y
CONFIG_CONSOLE_HANDLER=y
CONFIG_CONSOLE_GETCHAR=y
CONFIG_UART_INTERRUPT_DRIVEN=y
CONFIG_SERIAL=y
CONFIG_UART_LINE_CTRL=y
CONFIG_GPIO=y
CONFIG_CLOCK_CONTROL=y
CONFIG_CLOCK_CONTROL_NRF=y
CONFIG_MAIN_STACK_SIZE=2048
```

## boards/nrf54l15dk_nrf54l10_cpuapp.conf
```kconfig
#
# Copyright (c) 2024 Nordic Semiconductor
#
# SPDX-License-Identifier: LicenseRef-Nordic-5-Clause
#

CONFIG_NRFX_GPPI=y

# Note: UART baud rate configured via device tree
```

## boards/nrf54l15dk_nrf54l15_cpuapp.conf
```kconfig
#
# Copyright (c) 2024 Nordic Semiconductor
#
# SPDX-License-Identifier: LicenseRef-Nordic-5-Clause
#

CONFIG_NRFX_GPPI=y
CONFIG_BT_RX_STACK_SIZE=2048

# Note: UART baud rate must be configured in overlay file or set via menuconfig
# The default 115200 is used - increase if needed via device tree
```

## boards/nrf54l15dk_nrf54l15_cpuapp.overlay
```dts
/*
 * Copyright (c) 2024 Nordic Semiconductor ASA
 *
 * SPDX-License-Identifier: LicenseRef-Nordic-5-Clause
 */

/* UART baud rate set to 1M */
&uart20 {
	current-speed = <115200>;
};
```

## src/main.c
```c
/*
 * Copyright (c) 2024 Nordic Semiconductor ASA
 *
 * SPDX-License-Identifier: LicenseRef-Nordic-5-Clause
 */

#include <zephyr/kernel.h>
#include <zephyr/console/console.h>
#include "conn_time_sync.h"

int main(void)
{
	char role;

	console_init();

	do {
		printk("Choose device role - type c (central) or p (peripheral): ");
		role = console_getchar();
		printk("%c\n", role);

		switch (role) {
		case 'p':
		case 'P':
			printk("Peripheral. Starting ESB transmitter\n");
			peripheral_start();
			break;
		case 'c':
		case 'C':
			printk("Central. Starting ESB receiver\n");
			central_start();
			break;
		case '\n':
		case '\r':
			break;
		default:
			printk("Invalid choice '%c'. Please type 'c' or 'p'\n", role);
			break;
		}
	} while (role != 'c' && role != 'C' && role != 'p' && role != 'P');

	return 0;
}
```

## include/conn_time_sync.h
```c
#ifndef CONN_TIME_SYNC_H__
#define CONN_TIME_SYNC_H__

#include <zephyr/kernel.h>
#include <esb.h>

#define RADIO_FREQUENCY_MHZ    2400
#define ESB_CHANNEL            10
#define ESB_PIPE               0
#define RADIO_SEND_INTERVAL_MS 1000
#define RADIO_VALUE_MIN        1
#define RADIO_VALUE_MAX        10

struct radio_packet {
	uint8_t sequence;
	uint8_t value;
};

/** @brief Start central demo. */
void central_start(void);

/** @brief Start peripheral demo. */
void peripheral_start(void);

/** @brief Start the high-frequency clock required by the radio. */
int radio_hf_clock_start(void);

/** @brief Initialize the shared ESB link configuration. */
int esb_link_init(enum esb_mode mode, esb_event_handler event_handler);

static inline bool radio_value_is_valid(uint8_t value)
{
	return (value >= RADIO_VALUE_MIN) && (value <= RADIO_VALUE_MAX);
}

static inline void radio_packet_encode(struct esb_payload *payload,
				       const struct radio_packet *packet)
{
	payload->length = sizeof(*packet);
	payload->pipe = ESB_PIPE;
	payload->data[0] = packet->sequence;
	payload->data[1] = packet->value;
}

static inline bool radio_packet_decode(const struct esb_payload *payload,
				       struct radio_packet *packet)
{
	if (payload->length != sizeof(*packet)) {
		return false;
	}

	packet->sequence = payload->data[0];
	packet->value = payload->data[1];
	return radio_value_is_valid(packet->value);
}

#endif /* CONN_TIME_SYNC_H__ */
```

## src/central.c
```c
/*
 * Copyright (c) 2024 Nordic Semiconductor ASA
 *
 * SPDX-License-Identifier: LicenseRef-Nordic-5-Clause
 */

#include <zephyr/kernel.h>
#include <esb.h>

#include "conn_time_sync.h"

static struct {
	uint32_t received_count;
	uint8_t expected_sequence;
} rx_state;

static void event_handler(struct esb_evt const *event)
{
	struct esb_payload payload;
	struct radio_packet packet;

	if (event->evt_id != ESB_EVENT_RX_RECEIVED) {
		return;
	}

	while (esb_read_rx_payload(&payload) == 0) {
		if (!radio_packet_decode(&payload, &packet)) {
			continue;
		}

		rx_state.received_count++;
		printk("RX[%u] seq=%u value=%u%s\n",
		       rx_state.received_count,
		       packet.sequence,
		       packet.value,
		       (packet.sequence == rx_state.expected_sequence) ? "" : " (seq jump)");
		rx_state.expected_sequence = (uint8_t)(packet.sequence + 1U);
	}
}

void central_start(void)
{
	int err;

	printk("Starting central ESB RX on %u MHz\n",
	       RADIO_FREQUENCY_MHZ + ESB_CHANNEL);

	if (radio_hf_clock_start() != 0) {
		printk("Failed to start the HF clock for ESB RX\n");
		return;
	}

	err = esb_link_init(ESB_MODE_PRX, event_handler);
	if (err) {
		printk("ESB init failed: %d\n", err);
		return;
	}

	err = esb_start_rx();
	if (err) {
		printk("ESB RX start failed: %d\n", err);
		return;
	}

	printk("Listening for ESB values %u..%u on channel %u\n",
	       RADIO_VALUE_MIN, RADIO_VALUE_MAX, ESB_CHANNEL);

	while (1) {
		k_sleep(K_SECONDS(1));
	}
}
```

## src/controller_time_nrf54.c
```c
/*
 * Copyright (c) 2024 Nordic Semiconductor ASA
 *
 * SPDX-License-Identifier: LicenseRef-Nordic-5-Clause
 */

/** Stub implementation - not used in raw radio mode */

#include <zephyr/kernel.h>

/* Stub implementations for raw radio mode */

uint64_t controller_time_us_get(void)
{
	/* Return system time in microseconds */
	return k_uptime_ticks() * 1000 / CONFIG_SYS_CLOCK_HW_CYCLES_PER_SEC;
}

uint64_t system_time_us_get(void)
{
	/* Return system time in microseconds */
	return k_uptime_ticks() * 1000 / CONFIG_SYS_CLOCK_HW_CYCLES_PER_SEC;
}

void controller_time_trigger_set(uint64_t timestamp_us)
{
	/* Not used in raw radio mode */
	ARG_UNUSED(timestamp_us);
}

uint32_t controller_time_trigger_event_addr_get(void)
{
	/* Not used in raw radio mode */
	return 0;
}
```

## src/esb_link.c
```c
/*
 * Shared ESB clock and link setup for the central/peripheral demo.
 */

#include <zephyr/device.h>
#include <zephyr/devicetree.h>
#include <zephyr/drivers/clock_control.h>
#include <zephyr/drivers/clock_control/nrf_clock_control.h>
#include <zephyr/kernel.h>
#include <esb.h>
#include <nrf.h>
#include <nrf_erratas.h>

#if defined(CONFIG_CLOCK_CONTROL_NRF2)
#include <hal/nrf_lrcconf.h>
#endif

#if NRF54L_ERRATA_20_PRESENT
#include <hal/nrf_power.h>
#endif

#if defined(NRF54LM20A_ENGA_XXAA)
#include <hal/nrf_clock.h>
#endif

#include "conn_time_sync.h"

int radio_hf_clock_start(void)
{
#if defined(CONFIG_CLOCK_CONTROL_NRF)
	int err;
	int res;
	struct onoff_manager *clk_mgr;
	struct onoff_client clk_cli;

	clk_mgr = z_nrf_clock_control_get_onoff(CLOCK_CONTROL_NRF_SUBSYS_HF);
	if (!clk_mgr) {
		return -ENXIO;
	}

	sys_notify_init_spinwait(&clk_cli.notify);

	err = onoff_request(clk_mgr, &clk_cli);
	if (err < 0) {
		return err;
	}

	do {
		err = sys_notify_fetch_result(&clk_cli.notify, &res);
		if (!err && res) {
			return res;
		}
	} while (err == -EAGAIN);

#if NRF54L_ERRATA_20_PRESENT
	if (nrf54l_errata_20()) {
		nrf_power_task_trigger(NRF_POWER, NRF_POWER_TASK_CONSTLAT);
	}
#endif

#if defined(NRF54LM20A_ENGA_XXAA)
	nrf_clock_task_trigger(NRF_CLOCK, NRF_CLOCK_TASK_PLLSTART);
#endif

	return 0;
#elif defined(CONFIG_CLOCK_CONTROL_NRF2)
	int err;
	int res;
	const struct device *radio_clk_dev =
		DEVICE_DT_GET_OR_NULL(DT_CLOCKS_CTLR(DT_NODELABEL(radio)));
	struct onoff_client radio_cli;

	nrf_lrcconf_poweron_force_set(NRF_LRCCONF010,
				      NRF_LRCCONF_POWER_DOMAIN_1,
				      true);

	sys_notify_init_spinwait(&radio_cli.notify);

	err = nrf_clock_control_request(radio_clk_dev, NULL, &radio_cli);
	if (err < 0) {
		return err;
	}

	do {
		err = sys_notify_fetch_result(&radio_cli.notify, &res);
		if (!err && res) {
			return res;
		}
	} while (err == -EAGAIN);

	nrf_lrcconf_clock_always_run_force_set(NRF_LRCCONF000, 0, true);
	nrf_lrcconf_task_trigger(NRF_LRCCONF000, NRF_LRCCONF_TASK_CLKSTART_0);

	return 0;
#else
	return -ENOTSUP;
#endif
}

int esb_link_init(enum esb_mode mode, esb_event_handler event_handler)
{
	int err;
	uint8_t base_addr_0[4] = {0xE7, 0xE7, 0xE7, 0xE7};
	uint8_t base_addr_1[4] = {0xC2, 0xC2, 0xC2, 0xC2};
	uint8_t addr_prefix[8] = {0xE7, 0xC2, 0xC3, 0xC4, 0xC5, 0xC6, 0xC7, 0xC8};
	struct esb_config config = ESB_DEFAULT_CONFIG;

	config.protocol = ESB_PROTOCOL_ESB;
	config.mode = mode;
	config.event_handler = event_handler;
	config.bitrate = ESB_BITRATE_1MBPS;
	config.payload_length = sizeof(struct radio_packet);
	config.selective_auto_ack = false;
	config.retransmit_count = 0;

	err = esb_init(&config);
	if (err) {
		return err;
	}

	err = esb_set_base_address_0(base_addr_0);
	if (err) {
		return err;
	}

	err = esb_set_base_address_1(base_addr_1);
	if (err) {
		return err;
	}

	err = esb_set_prefixes(addr_prefix, ARRAY_SIZE(addr_prefix));
	if (err) {
		return err;
	}

	err = esb_set_rf_channel(ESB_CHANNEL);
	if (err) {
		return err;
	}

	return 0;
}
```

## src/peripheral.c
```c
/*
 * Copyright (c) 2024 Nordic Semiconductor ASA
 *
 * SPDX-License-Identifier: LicenseRef-Nordic-5-Clause
 */

#include <zephyr/kernel.h>
#include <esb.h>

#include "conn_time_sync.h"

static volatile bool tx_ready = true;
static struct radio_packet tx_packet = {
	.sequence = 0,
	.value = RADIO_VALUE_MIN,
};

static void event_handler(struct esb_evt const *event)
{
	switch (event->evt_id) {
	case ESB_EVENT_TX_SUCCESS:
	case ESB_EVENT_TX_FAILED:
		tx_ready = true;
		break;
	case ESB_EVENT_RX_RECEIVED:
		break;
	}
}

void peripheral_start(void)
{
	int err;
	struct esb_payload payload = {0};

	printk("Starting peripheral ESB TX on %u MHz\n",
	       RADIO_FREQUENCY_MHZ + ESB_CHANNEL);

	if (radio_hf_clock_start() != 0) {
		printk("Failed to start the HF clock for ESB TX\n");
		return;
	}

	err = esb_link_init(ESB_MODE_PTX, event_handler);
	if (err) {
		printk("ESB init failed: %d\n", err);
		return;
	}

	while (1) {
		if (!tx_ready) {
			k_sleep(K_MSEC(10));
			continue;
		}

		payload.noack = 1;
		radio_packet_encode(&payload, &tx_packet);
		tx_ready = false;
		esb_flush_tx();
		err = esb_write_payload(&payload);
		if (err) {
			tx_ready = true;
			printk("ESB TX enqueue failed: %d\n", err);
			k_sleep(K_MSEC(100));
			continue;
		}

		printk("TX seq=%u value=%u\n", tx_packet.sequence, tx_packet.value);

		tx_packet.sequence++;
		tx_packet.value++;
		if (tx_packet.value > RADIO_VALUE_MAX) {
			tx_packet.value = RADIO_VALUE_MIN;
		}

		k_sleep(K_MSEC(RADIO_SEND_INTERVAL_MS));
	}
}
```

## src/raw_radio_common.c
```c
/*
 * Copyright (c) 2024 Nordic Semiconductor ASA
 *
 * SPDX-License-Identifier: LicenseRef-Nordic-5-Clause
 */

#include <zephyr/device.h>
#include <zephyr/devicetree.h>
#include <zephyr/drivers/clock_control.h>
#include <zephyr/drivers/clock_control/nrf_clock_control.h>
#include <zephyr/kernel.h>
#include <esb.h>
#include <nrf.h>
#include <nrf_erratas.h>

#if defined(CONFIG_CLOCK_CONTROL_NRF2)
#include <hal/nrf_lrcconf.h>
#endif

#if NRF54L_ERRATA_20_PRESENT
#include <hal/nrf_power.h>
#endif

#if defined(NRF54LM20A_ENGA_XXAA)
#include <hal/nrf_clock.h>
#endif

#include "conn_time_sync.h"

int radio_hf_clock_start(void)
{
#if defined(CONFIG_CLOCK_CONTROL_NRF)
	int err;
	int res;
	struct onoff_manager *clk_mgr;
	struct onoff_client clk_cli;

	clk_mgr = z_nrf_clock_control_get_onoff(CLOCK_CONTROL_NRF_SUBSYS_HF);
	if (!clk_mgr) {
		return -ENXIO;
	}

	sys_notify_init_spinwait(&clk_cli.notify);

	err = onoff_request(clk_mgr, &clk_cli);
	if (err < 0) {
		return err;
	}

	do {
		err = sys_notify_fetch_result(&clk_cli.notify, &res);
		if (!err && res) {
			return res;
		}
	} while (err == -EAGAIN);

#if NRF54L_ERRATA_20_PRESENT
	if (nrf54l_errata_20()) {
		nrf_power_task_trigger(NRF_POWER, NRF_POWER_TASK_CONSTLAT);
	}
#endif

#if defined(NRF54LM20A_ENGA_XXAA)
	nrf_clock_task_trigger(NRF_CLOCK, NRF_CLOCK_TASK_PLLSTART);
#endif

	return 0;
#elif defined(CONFIG_CLOCK_CONTROL_NRF2)
	int err;
	int res;
	const struct device *radio_clk_dev =
		DEVICE_DT_GET_OR_NULL(DT_CLOCKS_CTLR(DT_NODELABEL(radio)));
	struct onoff_client radio_cli;

	nrf_lrcconf_poweron_force_set(NRF_LRCCONF010,
				      NRF_LRCCONF_POWER_DOMAIN_1,
				      true);

	sys_notify_init_spinwait(&radio_cli.notify);

	err = nrf_clock_control_request(radio_clk_dev, NULL, &radio_cli);
	if (err < 0) {
		return err;
	}

	do {
		err = sys_notify_fetch_result(&radio_cli.notify, &res);
		if (!err && res) {
			return res;
		}
	} while (err == -EAGAIN);

	nrf_lrcconf_clock_always_run_force_set(NRF_LRCCONF000, 0, true);
	nrf_lrcconf_task_trigger(NRF_LRCCONF000, NRF_LRCCONF_TASK_CLKSTART_0);

	return 0;
#else
	return -ENOTSUP;
#endif
}

int esb_link_init(enum esb_mode mode, esb_event_handler event_handler)
{
	int err;
	uint8_t base_addr_0[4] = {0xE7, 0xE7, 0xE7, 0xE7};
	uint8_t base_addr_1[4] = {0xC2, 0xC2, 0xC2, 0xC2};
	uint8_t addr_prefix[8] = {0xE7, 0xC2, 0xC3, 0xC4, 0xC5, 0xC6, 0xC7, 0xC8};
	struct esb_config config = ESB_DEFAULT_CONFIG;

	config.protocol = ESB_PROTOCOL_ESB;
	config.mode = mode;
	config.event_handler = event_handler;
	config.bitrate = ESB_BITRATE_1MBPS;
	config.payload_length = ESB_PAYLOAD_LENGTH;
	config.selective_auto_ack = false;
	config.retransmit_count = 0;

	err = esb_init(&config);
	if (err) {
		return err;
	}

	err = esb_set_base_address_0(base_addr_0);
	if (err) {
		return err;
	}

	err = esb_set_base_address_1(base_addr_1);
	if (err) {
		return err;
	}

	err = esb_set_prefixes(addr_prefix, ARRAY_SIZE(addr_prefix));
	if (err) {
		return err;
	}

	err = esb_set_rf_channel(ESB_CHANNEL);
	if (err) {
		return err;
	}

	return 0;
}
```

## src/timed_led_toggle.c
```c
/*
 * Copyright (c) 2024 Nordic Semiconductor ASA
 *
 * SPDX-License-Identifier: LicenseRef-Nordic-5-Clause
 */

#include <zephyr/kernel.h>
#include <zephyr/device.h>
#include <zephyr/drivers/gpio.h>

/* Stub implementation - not used in raw radio mode */

int timed_led_toggle_init(void)
{
	/* No LED toggling required for raw radio demo */
	return 0;
}

void timed_led_toggle_trigger_at(uint8_t value, uint32_t timestamp_us)
{
	/* No LED toggling required for raw radio demo */
	ARG_UNUSED(value);
	ARG_UNUSED(timestamp_us);
}
```
